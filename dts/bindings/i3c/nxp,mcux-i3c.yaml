## dts/bindings/i3c/nxp,mcux-i3c.yaml
```yaml
# Copyright (c) 2019 NXP
# Copyright (c) 2022 Intel Corporation
#
# SPDX-License-Identifier: Apache-2.0

description: NXP MCUX I3C controller

compatible: "nxp,mcux-i3c"

include: [i3c-controller.yaml, pinctrl-device.yaml]

properties:
  reg:
    required: true

  interrupts:
    required: true

  i3c-od-scl-hz:
    type: int
    description: |
      Open Drain Frequency for the I3C controller. When undefined, use
      the controller default or as specified by the I3C specification.

  clk-divider:
    type: int
    description: Main clock divider for I3C
    required: true

  clk-divider-tc:
    type: int
    description: TC clock divider for I3C
    required: true

  clk-divider-slow:
    type: int
    description: Slow clock divider for I3C
    required: true

  disable-open-drain-high-pp:
    type: boolean
    description: |
      If false, open drain high time is 1 PPBAUD count,
      which is short high and long low.
      If true, open drain high time is same as ODBAUD
      so that open drain clock is 50% duty cycle.
      Default is false.

  high-keeper:
    type: string
    default: "none"
    enum:
      - "none"
      - "wired-in"
      - "passive-sda"
      - "passive-sda-scl"
    description: |
      MCONFIG.HKEEP: how SDA (and SCL) are held high when no device drives
      them, e.g. in the hand-off after a target's end-of-data T-bit.
      "none" (the reset value) keeps the previous behaviour. Some targets
      release SDA right after SCL rises on that T-bit; if the controller
      drives SDA low only later, the bus shows a STOP then a START there.
      A high keeper closes that gap.
```
